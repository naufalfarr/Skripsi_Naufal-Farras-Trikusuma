#include <ESP8266WiFi.h>
#include <espnow.h>
#include <Arduino.h>

// Disable watchdog
extern "C" {
  #include "user_interface.h"
}

// Reduce buffer sizes
const int CLEFIA_BLOCK_SIZE = 16;
const int CLEFIA_KEY_SIZE = 32;
const int CLEFIA_ROUNDS = 32;

// Move constant arrays to PROGMEM to save RAM
const PROGMEM uint32_t con256[60] = {
    0xf56b7aeb, 0x994a8a42, 0x96a4bd75, 0xfa854521,
    0x735b768a, 0x1f7abac4, 0xd5bc3b45, 0xb99d5d62,
    0x52d73592, 0x3ef636e5, 0xc57a1ac9, 0xa95b9b72,
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    0x50b63150, 0x3c9757e7, 0x1052b098, 0x7c73b3a7
};

const PROGMEM uint8_t S0[256] = {
    0x57, 0x49, 0xD1, 0xC6, 0x2E, 0x98, 0xFE, 0x4A, 0x96, 0x40, 0xC7, 0x9B, 0x6E, 0xB2, 0x42, 0x51,
    0xE5, 0x1A, 0xBC, 0x21, 0xDF, 0xB9, 0x3B, 0x0A, 0xD0, 0x31, 0xDC, 0x29, 0x16, 0x33, 0xC9, 0x53,
    0x28, 0x51, 0x46, 0x22, 0xDC, 0x78, 0x4E, 0xA4, 0x02, 0x95, 0x82, 0x2B, 0xD3, 0xFF, 0x9D, 0x6F,
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    0xE8, 0x7D, 0x3B, 0xA2, 0x6C, 0x3C, 0x91, 0xBD, 0x41, 0xD6, 0x7F, 0x73, 0x3A, 0x04, 0xC3, 0xB0
};

const PROGMEM uint8_t S1[256] = {
    0x52, 0x09, 0x6A, 0xD5, 0x30, 0x36, 0xA5, 0x38, 0xBF, 0x40, 0xA3, 0x9E, 0x81, 0xF3, 0xD7, 0xFB,
    0x7C, 0xE3, 0x39, 0x82, 0x9B, 0x2F, 0xFF, 0x87, 0x34, 0x8E, 0x43, 0x44, 0xC4, 0xDE, 0xE9, 0xCB,
    0x54, 0x7B, 0x94, 0x32, 0xA6, 0xC2, 0x23, 0x3D, 0xEE, 0x4C, 0x95, 0x0B, 0x42, 0xFA, 0xC3, 0x4E,
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    0x17, 0x2B, 0x04, 0x7E, 0xBA, 0x77, 0xD6, 0x26, 0xE1, 0x69, 0x14, 0x63, 0x55, 0x21, 0x0C, 0x7D
};

// Helper functions with inline optimization
inline uint32_t rotl(uint32_t x, int s) {
    return (x << s) | (x >> (32 - s));
}

inline uint32_t rotr(uint32_t x, int s) {
    return (x >> s) | (x << (32 - s));
}

// Read from PROGMEM helpers
inline uint32_t pgm_read_con256(int index) {
    return pgm_read_dword(&con256[index]);
}

inline uint8_t pgm_read_S0(int index) {
    return pgm_read_byte(&S0[index]);
}

inline uint8_t pgm_read_S1(int index) {
    return pgm_read_byte(&S1[index]);
}

// Optimized F-function (same as in sender)
void ICACHE_RAM_ATTR clefiaF(uint32_t *dst, const uint32_t *src, int offset) {
    uint32_t x = src[0] ^ pgm_read_con256(offset);
    uint32_t y = src[1];
    uint32_t z = pgm_read_con256(offset);

    y ^= rotr(x, 8) ^ rotl(x, 16) ^ rotl(x, 24);
    
    uint32_t temp = 0;
    temp |= ((uint32_t)pgm_read_S0((uint8_t)(y >> 24))) << 0;
    temp |= ((uint32_t)pgm_read_S1((uint8_t)(y >> 16))) << 8;
    temp |= ((uint32_t)pgm_read_S0((uint8_t)(y >> 8))) << 16;
    temp |= ((uint32_t)pgm_read_S1((uint8_t)y)) << 24;
    
    dst[0] = temp ^ z;
    dst[1] = y;
    
    ESP.wdtFeed(); // Feed the watchdog
}

// Optimized key scheduling with more frequent yields
void ICACHE_RAM_ATTR clefiaKeySchedule(uint32_t *rk, const uint8_t *key) {
    uint32_t L[4], R[4];
    
    for (int i = 0; i < 4; i++) {
        L[i] = ((uint32_t)key[4*i+3] << 24) | 
               ((uint32_t)key[4*i+2] << 16) |
               ((uint32_t)key[4*i+1] << 8) | 
               ((uint32_t)key[4*i]);
        ESP.wdtFeed();
    }

    for (int i = 0; i < CLEFIA_ROUNDS / 4; i++) {
        memcpy(R, L, 16);
        
        clefiaF(&R[0], &R[2], i*4);
        clefiaF(&R[2], &R[0], i*4+2);
        
        for (int j = 0; j < 4; j++) {
            rk[i*4 + j] = R[j];
        }
        
        if (i % 2 == 0) {
            for (int j = 0; j < 4; j++) {
                L[j] ^= rotl(R[j], 15);
            }
        } else {
            for (int j = 0; j < 4; j++) {
                L[j] ^= rotl(R[j], 17);
            }
        }
        
        ESP.wdtFeed();
    }

    for (int i = 0; i < 4; i++) {
        rk[CLEFIA_ROUNDS + i] = L[i];
    }
}

// Optimized decryption function with more frequent yields
void ICACHE_RAM_ATTR clefiaDecrypt(uint32_t *plaintext, const uint32_t *ciphertext, const uint32_t *rk) {
    uint32_t L[2], R[2], T[2];
    
    R[0] = ciphertext[0] ^ rk[CLEFIA_ROUNDS];
    R[1] = ciphertext[1] ^ rk[CLEFIA_ROUNDS + 1];
    L[0] = ciphertext[2] ^ rk[CLEFIA_ROUNDS + 2];
    L[1] = ciphertext[3] ^ rk[CLEFIA_ROUNDS + 3];
    
    for (int i = CLEFIA_ROUNDS - 1; i >= 0; i -= 2) {
        clefiaF(T, R, i - 1);
        T[0] ^= L[0];
        T[1] ^= L[1];
        
        memcpy(L, R, 8);
        memcpy(R, T, 8);
        
        if (i % 4 == 0) ESP.wdtFeed(); // More frequent watchdog feeds
    }
    
    plaintext[0] = R[0] ^ rk[0];
    plaintext[1] = R[1] ^ rk[1];
    plaintext[2] = L[0] ^ rk[2];
    plaintext[3] = L[1] ^ rk[3];
}

// Global variables for round keys and received data
static uint32_t roundKeys[CLEFIA_ROUNDS + 4];
static uint8_t receivedData[CLEFIA_BLOCK_SIZE];
static bool dataReceived = false;

void ICACHE_RAM_ATTR OnDataRecv(uint8_t *mac_addr, uint8_t *data, uint8_t len) {
    if (len == CLEFIA_BLOCK_SIZE) {
        memcpy(receivedData, data, CLEFIA_BLOCK_SIZE);
        dataReceived = true;
    }
    ESP.wdtFeed();
}

void setup() {
    ESP.wdtDisable();
    ESP.wdtEnable(WDTO_8S);
    
    Serial.begin(115200);
    while (!Serial) { ESP.wdtFeed(); }

    WiFi.mode(WIFI_STA);
    WiFi.disconnect();
    delay(100);

    if (esp_now_init() != 0) {
        Serial.println("Error initializing ESP-NOW");
        return;
    }
    
    esp_now_set_self_role(ESP_NOW_ROLE_SLAVE);
    esp_now_register_recv_cb(OnDataRecv);

    // Pre-compute round keys
    static const uint8_t key[CLEFIA_KEY_SIZE] = {
        0x01, 0x23, 0x45, 0x67, 0x89, 0xAB, 0xCD, 0xEF,
        0xFE, 0xDC, 0xBA, 0x98, 0x76, 0x54, 0x32, 0x10,
        0x00, 0x11, 0x22, 0x33, 0x44, 0x55, 0x66, 0x77,
        0x88, 0x99, 0xAA, 0xBB, 0xCC, 0xDD, 0xEE, 0xFF
    };
    clefiaKeySchedule(roundKeys, key);

    Serial.println("Receiver setup completed");
}

void loop() {
    if (dataReceived) {
        uint8_t decryptedMessage[CLEFIA_BLOCK_SIZE];
        clefiaDecrypt((uint32_t*)decryptedMessage, (const uint32_t*)receivedData, roundKeys);

        Serial.print("Decrypted Message: ");
        Serial.write(decryptedMessage, CLEFIA_BLOCK_SIZE);
        Serial.println();

        dataReceived = false;
    }
    
    ESP.wdtFeed();
    delay(10); // Small delay to prevent tight looping
}